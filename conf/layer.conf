## conf/layer.conf
```bitbake
# We have a conf directory, add to BBPATH
BBPATH .= ":${LAYERDIR}"
#BBPATH := "${BBPATH}${LAYERDIR}"

# We have a packages directory, add to BBFILES
BBFILES += "${LAYERDIR}/recipes*/*/*.bb ${LAYERDIR}/recipes*/*/*.bbappend"

BBFILE_COLLECTIONS += "meta-pia"
BBFILE_PATTERN_meta-pia := "^${LAYERDIR}/"
BBFILE_PRIORITY_meta-pia = "5"
```

## conf/machine/pia-am35x.conf
```bitbake
#@TYPE: Machine
#@NAME: pironex piA machine
#@DESCRIPTION: Machine configuration for the AM3517 piA board

TARGET_ARCH = "arm"
PREFERRED_PROVIDER_virtual/xserver = "xserver-xorg"
XSERVER = "xserver-xorg \
           xf86-input-evdev \
           xf86-input-mouse \
           xf86-video-omapfb \
           xf86-input-keyboard"

# Only has DVI connector for external screen
GUI_MACHINE_CLASS = "smallscreen"

require conf/machine/include/omap3.inc

# Ship all kernel modules

IMAGE_FSTYPES ?= "ubi jffs2 tar.bz2"
#IMAGE_FSTYPES ?= "tar.bz2 ubi"
EXTRA_IMAGECMD_jffs2 = "-lnp -e 0x20000 -s 2048"
#EXTRA_IMAGEDEPENDS += " u-boot x-load"
EXTRA_IMAGEDEPENDS += " u-boot"

SERIAL_CONSOLE = "115200 ttyO2"
USE_VT = "2"

#PREFERRED_PROVIDER_virtual/kernel = "linux-omap-psp"
PREFERRED_PROVIDER_virtual/kernel = "linux-pia"
#PREFERRED_VERSION_linux-omap = "2.6.37"

PREFERRED_PROVIDER_virtual/bootloader = "u-boot"

UBOOT_ARCH = "arm"
UBOOT_MACHINE = "am35x_pia_config"
XLOAD_MACHINE = "am3517crane_config"

#MACHINE_FEATURES = "kernel26 apm usbgadget usbhost vfat ext2 screen ethernet bluetooth wifi touchscreen alsa keyboard"
MACHINE_FEATURES = "kernel26 apm usbhost vfat ext2 screen ethernet touchscreen alsa keyboard wifi"

#module_autoload_g_serial = "g_serial"

# NOTE: there are NAND and OneNAND versions of this board...

# do ubiattach /dev/ubi_ctrl -m 4
# From dmesg:
# UBI: smallest flash I/O unit:    2048
# UBI: logical eraseblock size:    129024 bytes
# from ubiattach stdout:
# UBI device number 0, total 1996 LEBs
MKUBIFS_ARGS = "-m 2048 -e 129024 -c 1996"

# do ubiattach /dev/ubi_ctrl -m 4
# from dmesg:
# UBI: smallest flash I/O unit:    2048
# UBI: physical eraseblock size:   131072 bytes (128 KiB)
# UBI: sub-page size:              512
UBINIZE_ARGS = "-m 2048 -p 128KiB -s 512"

# don't use release version, it doesn't work with current kernel
# this is upstream commit 578563341a44215f86612c95a9afbea6a298b742
PREFERRED_VERSION_tslib= "1.0+gitr%"
#PREFERRED_PROVIDER_libqwt-dev = "qwt-e"
#PREFERRED_VERSION_qt4-embedded = "4.7.3"
#PREFERRED_VERSION_qt4-embedded-gles = ""
#PREFERRED_PROVICER_qt4 = "qt4-embedded"
PREFERRED_PROVIDER_qt4-embedded = "qt4-embedded"
#PREFERRED_PROVIDER_qwt = "qwt-e"
PREFERRED_PROVIDER_qwt-e = "qwt-e"
PREFERRED_PROVIDER_gcc = "gcc"
#PREFERRED_PROVIDER_mysql = "mysql5"
PREFERRED_PROVIDER_mysql5 =" "mysql5"
PREFERRED_PROVIDER_gdbserver = "gdbserver"

# this must be overridden via _local
PREFERRED_VERSION_udev = "173"

#LINUX_LIBC_HEADERS_VERSION ?= "3.2"

#PREFERRED_VERSION_autoconf = "2.68"
#PREFERRED_VERSION_autoconf-native = "2.68"
PREFERRED_VERSION_binutils = "2.22"
PREFERRED_VERSION_binutils-native = "2.22"
PREFERRED_VERSION_binutils-cross = "2.22"
PREFERRED_VERSION_binutils-native = "2.22"
```
